## meta-zuehlke/conf/layer.conf
```bitbake
# We have a conf and classes directory, append to BBPATH
BBPATH .= ":${LAYERDIR}"

# We have a recipes directory containing .bb and .bbappend files, add to BBFILES
BBFILES += "${LAYERDIR}/recipes*/*/*.bb \
            ${LAYERDIR}/recipes*/*/*.bbappend"

BBFILE_COLLECTIONS += "zuehlke"
BBFILE_PATTERN_zuehlke := "^${LAYERDIR}/"
BBFILE_PRIORITY_zuehlke = "10"

LAYERSERIES_COMPAT_zuehlke = "kirkstone"
```
